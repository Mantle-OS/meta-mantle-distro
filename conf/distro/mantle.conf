## conf/distro/mantle.conf
```bitbake
require conf/distro/poky.conf

DISTRO = "mantle"
DISTRO_NAME = "Mantle OS - ${DISTRO_RELEASE}"
DISTRO_CODENAME =  "hadean"
MAINTAINER = "Joseph Mills <josephjamesmills@gmail.com>"

## Set the following in the MACHINE conf file
VIRTUAL-RUNTIME_gl   ?= ""
VIRTUAL-RUNTIME_egl  ?= ""
VIRTUAL-RUNTIME_gles ?= ""
VIRTUAL-RUNTIME_glu  ?= ""
VIRTUAL-RUNTIME_drm  ?= ""
VIRTUAL-RUNTIME_gbm  ?= ""
VIRTUAL-RUNTIME_vulkan ?= ""
VIRTUAL-RUNTIME_glut ?= "freeglut"
PREFERRED_PROVIDER_virtual/freeglut = "${VIRTUAL-RUNTIME_glut}"

## Set the following in the IMAGE bb file
VIRTUAL-RUNTIME_dm ?= ""
VIRTUAL-RUNTIME_de ?= ""
VIRTUAL-RUNTIME_wm ?= ""
VIRTUAL-RUNTIME_font ?= "freetype"
VIRTUAL-RUNTIME_input ?= "libinput"
VIRTUAL-RUNTIME_network_manager ?= ""

DISTRO_GRAPHICS_FEATURES_DEFAULTS ?= " \
    opengl \
    opencl \
    directfb \
    kms \
    wayland \
    vulkan \
    x11 \
    ${@bb.utils.contains_any('BBFILE_COLLECTIONS', 'qt6-layer qt5-layer', ' eglfs', '', d)} \
"

DISTRO_FEATURES_DEFAULTS = "\
    acl \
    alsa pulseaudio pipewire jack \
    bluetooth wifi \
    ipv4 ipv6 nfs zeroconf 3g nfc \
    xattr \
    vfat \
    gobject-introspection-data \
    ldconfig \
    pci  \
    seccomp \
    virtualization \
    polkit \
    pam \
    gstreamer \
    ${@bb.utils.contains_any('BBFILE_COLLECTIONS', 'qt6-layer qt5-layer', ' webengine', '', d)} \
    ${DISTRO_GRAPHICS_FEATURES_DEFAULTS} \
"

RELEASE_DATE = "${@d.getVar('DATE')[:4] + '-' + d.getVar('DATE')[4:6] + '-' + d.getVar('DATE')[6:8]}"
DISTRO_VERSION = "0.0.2"
DISTRO_RELEASE ?= "development"

SDK_VENDOR = "-mantle"
SDK_NAME = "${DISTRO}-${MACHINE}-${TUNE_PKGARCH}-${TCLIBC}-toolchain-${SDK_ARCH}-${SDK_VERSION}"
SDKPATHINSTALL = "/opt/${DISTRO}-${DISTRO_CODENAME}-oe-sdks/${MACHINE}-${TUNE_PKGARCH}-${TCLIBC}-${SDK_VERSION}"

LICENSE_FLAGS_ACCEPTED:append = " \
    commercial \
    commercial_libav \
    commercial_mpg123 \
    commercial_x264 \
    commercial_libpostproc \
    commercial_gst-ffmpeg \
    commercial_gst-plugins-ugly \
    commercial_libmad \
    commercial_mpeg2dec \
    commercial_lame \
    nvidia_cuda \
"

## oe/poky
# DISTRO_FEATURES:append = "
#     ${DISTRO_FEATURES_DEFAULTS}
# "

# later hurd needs ext2 lol
DISTRO_FEATURES:remove = " \
    debuginfod ptest \
    ${@bb.utils.contains_any('BBFILE_COLLECTIONS', 'meta-hurd', '', 'ext2', d)} \
"

PREFERRED_RPROVIDER_ssh = "openssh"
```
