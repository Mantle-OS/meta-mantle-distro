## conf/distro/include/fortan.inc
```bitbake
FORTRAN:forcevariable = "${@bb.utils.contains('MANTLE_FORTRAN', 'TRUE', ',fortran', '', d)}"
```

## conf/distro/include/unix-tools-busybox.inc
```bitbake
PREFERRED_PROVIDER_virtual/base-utils = "busybox"
VIRTUAL-RUNTIME_base-utils = "busybox"
VIRTUAL-RUNTIME_base-utils-hwclock = "busybox-hwclock"
VIRTUAL-RUNTIME_base-utils-syslog = "busybox-syslog"

CORE_IMAGE_EXTRA_RDEPENDS:append " busybox "
```

## conf/distro/include/unix-tools-coreutils.inc
```bitbake
PREFERRED_PROVIDER_virtual/base-utils = "packagegroup-core-base-utils"
VIRTUAL-RUNTIME_base-utils = "packagegroup-core-base-utils"
VIRTUAL-RUNTIME_base-utils-hwclock = "util-linux-hwclock"
VIRTUAL-RUNTIME_base-utils-syslog = ""

CORE_IMAGE_EXTRA_RDEPENDS:append = " packagegroup-core-full-cmdline "
```

## conf/distro/include/unix-tools-toybox.inc
```bitbake
PREFERRED_PROVIDER_virtual/base-utils = "toybox"
VIRTUAL-RUNTIME_base-utils = "toybox"

CORE_IMAGE_EXTRA_RDEPENDS:append " toybox "
```

## conf/distro/mantle.conf
```bitbake
require conf/distro/poky.conf

MANTLE_INIT_TYPE ?= "systemd"
INIT_MANAGER = "${MANTLE_INIT_TYPE}"

MANTLE_POSIX_TYPE   ?= "coreutils"
require conf/distro/include/unix-tools-${MANTLE_POSIX_TYPE}.inc

DISTRO_GRAPHICS_FEATURES ?= " \
    vulkan \
    x11 \
    wayland \
    opengl \
    directfb \
"

MANTLE_FORTRAN ?= "TRUE"
require conf/distro/include/fortan.inc

DISTRO = "mantle"
DISTRO_NAME = "Mantle OS - ${DISTRO_RELEASE}"
DISTRO_CODENAME =  "hadean"
MAINTAINER = "Joseph Mills <josephjamesmills@gmail.com.com>"

RELEASE_DATE = "${@d.getVar('DATE')[:4] + '-' + d.getVar('DATE')[4:6] + '-' + d.getVar('DATE')[6:8]}"
DISTRO_VERSION = "0.0.1"
DISTRO_RELEASE ?= "development"

SDK_VENDOR = "-mantle"
SDK_NAME = "${DISTRO}-${MACHINE}-${TUNE_PKGARCH}-${TCLIBC}-toolchain-${SDK_ARCH}-${SDK_VERSION}"
SDKPATHINSTALL = "/opt/${DISTRO}-${DISTRO_CODENAME}-oe-sdks/${MACHINE}-${TUNE_PKGARCH}-${TCLIBC}-${SDK_VERSION}"

LICENSE_FLAGS_ACCEPTED:append = " \
    commercial \
    commercial_libav \
    commercial_mpg123 \
    commercial_x264 \
    commercial_libpostproc \
    commercial_gst-ffmpeg \
    commercial_gst-plugins-ugly \
    commercial_libmad \
    commercial_mpeg2dec \
    commercial_lame \
"

## oe/poky
DISTRO_FEATURES:remove = "debuginfod ptest"
DISTRO_FEATURES:append = " \
    pam \
    ${@bb.utils.contains_any('BBFILE_COLLECTIONS', 'qt6-layer qt5-layer', ' webengine', '', d)} \
    polkit \
"
# later hurd needs ext2 lol
DISTRO_FEATURES:remove = " \
    ${@bb.utils.contains_any('BBFILE_COLLECTIONS', 'meta-hurd', '', 'ext2', d)} \
"

# meta-virtualization
DISTRO_FEATURES:append =  " virtualization seccomp "

#meta-qt -> webengine building
DISTRO_FEATURES:append = "${@bb.utils.contains_any('BBFILE_COLLECTIONS', 'qt5-layer qt6-layer', ' webengine', '', d)}"

PREFERRED_RPROVIDER_ssh = "openssh"


#required-distro-features.inc  wayland-protocols_1.45.bb  weston_14.0.2.bb
#libinput_1.29.1.bb  wayland                       wayland-utils_1.2.0.bb     weston-init
#mtdev_1.1.7.bb      wayland_1.24.0.bb             weston                     weston-init.bb
```

## conf/layer.conf
```bitbake
# We have a conf and classes directory, add to BBPATH
BBPATH =. "${LAYERDIR}:"

# We have recipes-* directories, add to BBFILES
BBFILES += "${LAYERDIR}/recipes-*/*/*.bb \
            ${LAYERDIR}/recipes-*/*/*.bbappend"

BBFILE_COLLECTIONS += "mantle-distro-layer"
BBFILE_PATTERN_mantle-distro-layer = "^${LAYERDIR}/"
BBFILE_PRIORITY_mantle-distro-layer = "20"

## FIXME this distro depends on so much more
#    qt5-layer
LAYERDEPENDS_mantle-distro-layer = " \
    core yocto yoctobsp \
    \
    openembedded-layer \
    filesystems-layer \
    networking-layer \
    perl-layer \
    meta-python \
    multimedia-layer \
    meta-initramfs \
    xfce-layer \
    gnome-layer \
    webserver \
    \
    qt6-layer \
    kf6-layer \
    \
    iot-cloud \
    virtualization-layer \
    scarthgap-rust-mixin \
    meta-python2 \
    meta-noto \
    mantle-bsp \
    meta-mantle-java \
    mantle-office-layer \
    flutter-layer \
    erlang-layer \
    clang-layer \
    chromium-browser-layer \
"

LAYERSERIES_COMPAT_mantle-distro-layer = "scarthgap"
LICENSE_PATH:append = " ${LAYERDIR}/licenses "

# poky
BBFILES_DYNAMIC += " \
    core:${LAYERDIR}/dynamic-layers/poky/meta/recipes-*/*/*.bb \
    core:${LAYERDIR}/dynamic-layers/poky/meta/recipes-*/*/*.bbappend \
"

# OE
BBFILES_DYNAMIC += " \
    openembedded-layer:${LAYERDIR}/dynamic-layers/meta-openembedded/openembedded-layer/recipes-*/*/*.bb \
    openembedded-layer:${LAYERDIR}/dynamic-layers/meta-openembedded/openembedded-layer/recipes-*/*/*.bbappend \
    xfce-layer:${LAYERDIR}/dynamic-layers/meta-openembedded/xfce-layer/recipes-*/*/*.bb \
    xfce-layer:${LAYERDIR}/dynamic-layers/meta-openembedded/xfce-layer/recipes-*/*/*.bbappend \
    gnome-layer:${LAYERDIR}/dynamic-layers/meta-openembedded/gnome-layer/recipes-*/*/*.bb \
    gnome-layer:${LAYERDIR}/dynamic-layers/meta-openembedded/gnome-layer/recipes-*/*/*.bbappend \
    webserver:${LAYERDIR}/dynamic-layers/meta-openembedded/webserver-layer/recipes-*/*/*.bb \
    webserver:${LAYERDIR}/dynamic-layers/meta-openembedded/webserver-layer/recipes-*/*/*.bbappend \
    perl-layer:${LAYERDIR}/dynamic-layers/meta-openembedded/perl-layer/recipes-*/*/*.bb \
    perl-layer:${LAYERDIR}/dynamic-layers/meta-openembedded/perl-layer/recipes-*/*/*.bbappend \
    multimedia-layer:${LAYERDIR}/dynamic-layers/meta-openembedded/multimedia-layer/recipes-*/*/*.bb \
    multimedia-layer:${LAYERDIR}/dynamic-layers/meta-openembedded/multimedia-layer/recipes-*/*/*.bbappend \
"

## tier 2
BBFILES_DYNAMIC += " \
    qt5-layer:${LAYERDIR}/dynamic-layers/qt5-layer/recipes-*/*/*.bb \
    qt5-layer:${LAYERDIR}/dynamic-layers/qt5-layer/recipes-*/*/*.bbappend \
    qt6-layer:${LAYERDIR}/dynamic-layers/qt6-layer/recipes-*/*/*.bb \
    qt6-layer:${LAYERDIR}/dynamic-layers/qt6-layer/recipes-*/*/*.bbappend \
    chromium-browser-layer:${LAYERDIR}/dynamic-layers/chromium-browser-layer/recipes-*/*/*.bb \
    chromium-browser-layer:${LAYERDIR}/dynamic-layers/chromium-browser-layer/recipes-*/*/*.bbappend \
    flutter-layer:${LAYERDIR}/dynamic-layers/flutter-layer/recipes-*/*/*.bb \
    flutter-layer:${LAYERDIR}/dynamic-layers/flutter-layer/recipes-*/*/*.bbappend \
"
# broken atm
#   neuralnetwork:${LAYERDIR}/dynamic-layers/ai-layer/recipes-*/*/*.bb 
#    neuralnetwork:${LAYERDIR}/dynamic-layers/ai-layer/recipes-*/*/*.bbappend 
```
